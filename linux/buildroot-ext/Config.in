## linux/buildroot-ext/Config.in
```kconfig
source "$BR2_EXTERNAL_SONATALINUX_PATH/package/tcc/Config.in"
source "$BR2_EXTERNAL_SONATALINUX_PATH/package/gcc142/Config.in"
source "$BR2_EXTERNAL_SONATALINUX_PATH/package/ocaml3/Config.in"
```

## linux/buildroot-ext/package/gcc142/Config.in
```kconfig
config BR2_PACKAGE_GCC142
	bool "gcc142"
	help
	  GCC 1.42 with RV32 backend - a minimal C compiler that generates
	  RISC-V assembly. Uses pre-generated insn-* files from the host
	  build to avoid needing to run generator programs.

	  Installs cc1, cpp, and gcc driver for on-target compilation.
```

## linux/buildroot-ext/package/ocaml3/Config.in
```kconfig
config BR2_PACKAGE_OCAML3
	bool "ocaml3"
	help
	  OCaml 3.07 bytecode interpreter and interactive toplevel.

	  Builds the native ocamlrun bytecode interpreter for the target,
	  and installs the host-built OCaml toplevel and standard library
	  (bytecode is architecture-independent).

	  https://github.com/ocaml/ocaml
```

## linux/buildroot-ext/package/tcc/Config.in
```kconfig
config BR2_PACKAGE_TCC
	bool "tcc"
	help
	  Tiny C Compiler — a small, fast C compiler that can compile
	  and run C code directly.  This builds a riscv32 cross from
	  the jrrk2/tinycc fork which has riscv32 target support.

	  Also installs musl C headers and CRT files so tcc can
	  compile and link programs on-target.

	  https://github.com/jrrk2/tinycc
```

## qemu-sonata/patches/hw/riscv/Kconfig.patch
```kconfig
--- a/hw/riscv/Kconfig
+++ b/hw/riscv/Kconfig
@@ -1,3 +1,12 @@
+config SONATA
+    bool
+    select IBEX
+    select RISCV_ACLINT
+    select SIFIVE_PLIC
+    select UNIMP
+    default y if TARGET_RISCV32
+
 config RISCV_NUMA
     bool
```
